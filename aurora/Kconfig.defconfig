## aurora/Kconfig.defconfig
```kconfig
# Copyright (c) 2023 The ZMK Contributors
# SPDX-License-Identifier: MIT

if SHIELD_AURORA

config ZMK_KEYBOARD_NAME
    default "Aurora"

endif
```

## aurora/Kconfig.shield
```kconfig
# Copyright (c) 2023 The ZMK Contributors
# SPDX-License-Identifier: MIT

config SHIELD_AURORA
    def_bool $(shields_list_contains,aurora)
```
